## arch/arm/configs/mdm9615-fx30_defconfig
```kconfig
# Add-on config file for FX30 3G product. Add this config to the bottom of
# mdm9615_defconfig .
CONFIG_SIERRA_AIRLINK_COLUMBIA=y
CONFIG_SENSORS_ADS1015=y
CONFIG_NF_CONNTRACK_IPV6=y
CONFIG_SIERRA_MSM_HSL_RS485=y
CONFIG_EEPROM_AT24=y
CONFIG_I2C_MUX=y
# CONFIG_I2C_ARB_GPIO_CHALLENGE is not set
# CONFIG_I2C_MUX_GPIO is not set
# CONFIG_I2C_MUX_PCA9541 is not set
CONFIG_I2C_MUX_PCA954x=y
CONFIG_GPIO_SX150X=y
CONFIG_GPIO_PCA953X=y
# CONFIG_GPIO_PCA953X_IRQ is not set
```
